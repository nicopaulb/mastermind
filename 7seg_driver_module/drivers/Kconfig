## 7seg_driver_module/drivers/auxdisplay/seg74hc595/Kconfig
```kconfig
config AUXDISPLAY_74HC595
	bool "74HC595 7-segment display support"
	depends on DT_HAS_ZEPHYR_SEG74HC595_ENABLED
	select SPI
    select GPIO
	help
      Enable driver for 74HC595 7-segment LED display.
	  This driver supports 4-digit 7-segment displays commonly found in clock modules
	  and simple numeric displays.

	  This driver implements the auxdisplay API, allowing generic display usage.
	  Helper APIs for direct number display are also available.
```

## 7seg_driver_module/dts/bindings/auxdisplay/zephyr,seg74hc595.yaml
```yaml
description: 74HC595 7-segment LED display controller

compatible: "zephyr,seg74hc595"

include: spi-device.yaml

properties:
  latch-gpios:
    type: phandle-array
    required: true
    description: Latch GPIO pin

  digits:
    type: int
    required: true
    description: Number of digits (Maximum 4)

  common-anode:
    type: boolean
    description: Set to true if the display is common anode, false if common cathode
```
